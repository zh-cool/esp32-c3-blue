## sdkconfig.defaults
```kconfig
# ESP32-C3 + 4MB Flash + NimBLE BLE 协议栈
CONFIG_ESPTOOLPY_FLASHSIZE_4MB=y
CONFIG_BT_ENABLED=y
CONFIG_BT_NIMBLE_ENABLED=y
CONFIG_BT_NIMBLE_ATT_PREFERRED_MTU=512
CONFIG_BT_NIMBLE_HOST_TASK_STACK_SIZE=12288
CONFIG_PARTITION_TABLE_TWO_OTA=y
```
